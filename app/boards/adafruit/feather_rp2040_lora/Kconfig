## app/boards/quanta/entangler_rp2040/Kconfig.board
```kconfig
config BOARD_QUANTA_ENTANGLER_RP2040
    bool "Quanta Entangler board"
    depends on SOC_RP2040
```

## app/boards/quanta/entangler_rp2040/Kconfig.defconfig
```kconfig
if BOARD_QUANTA_ENTANGLER_RP2040

config USB_SELF_POWERED
	default n

if LORA || FILE_SYSTEM_LITTLEFS

    config MAIN_STACK_SIZE
        default 4096

    config HEAP_MEM_POOL_ADD_SIZE_BOARD
        int
        default 16384

endif # LORA || FILE_SYSTEM_LITTLEFS

if LORA

    config LORA_SX127X
        default y

endif # LORA

if FILE_SYSTEM_LITTLEFS

    config FS_LITTLEFS_FMP_DEV
        default y

endif # FILE_SYSTEM_LITTLEFS

if I2C_DW

config I2C_DW_CLOCK_SPEED
	default 125

endif # I2C_DW

endif # BOARD_QUANTA_ENTANGLER_RP2040
```

## app/boards/quanta/entangler_rp2040/board.yml
```yaml
board:
  name: quanta_entangler_rp2040
  full_name: Entangler RP2040
  vendor: quanta
  socs:
    - name: rp2040
```

## boards/adafruit/feather_rp2040_lora/board.yml
```yaml
board:
  name: adafruit_feather_rp2040_lora
  full_name: Feather RP2040 LoRa
  vendor: adafruit
  socs:
    - name: rp2040
```

## west.yml
```yaml
manifest:
  self:
    path: .
  remotes:
    - name: zephyrproject
      url-base: https://github.com/zephyrproject-rtos
  projects:
    - name: zephyr
      repo-path: zephyr
      remote: zephyrproject
      revision: main
      clone-depth: 1
      import:
        path-prefix: external
        name-allowlist:
          - cmsis
          - cmsis-dsp
          - picolibc
          - segger
          - hal_rpi_pico
          - loramac-node
          - littlefs

module:
  - name: quanta_modbus
    path: modules/quanta_modbus
```
